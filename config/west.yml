## config/west.yml
```yaml
manifest:
  remotes:
    - name: zmkfirmware
      url-base: https://github.com/zmkfirmware
    - name: caksoylar
      url-base: https://github.com/caksoylar
    - name: englmaxi
      url-base: https://github.com/englmaxi
    - name: dhruvinsh
      url-base: https://github.com/dhruvinsh
  projects:
    - name: zmk
      remote: zmkfirmware
      revision: v0.3
      import: app/west.yml
    - name: zmk-rgbled-widget
      remote: caksoylar
      revision: v0.3
    - name: zmk-dongle-display
      remote: englmaxi
      revision: v0.3
    - name: zmk-tri-state
      remote: dhruvinsh
      revision: main
  self:
    path: config
```
